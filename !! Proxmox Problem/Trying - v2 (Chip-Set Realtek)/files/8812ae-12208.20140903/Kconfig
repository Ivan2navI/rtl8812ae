## !! Proxmox Problem/Trying - v2 (Chip-Set Realtek)/files/8812ae-12208.20140903/Kconfig
```kconfig
config RTL8821AE
	tristate "Realtek 8812A PCI WiFi"
	depends on PCI
	---help---
	  Help message of RTL8812AE
```
